## Firmware/boards/Slotech/gecko_development/Kconfig.defconfig
```kconfig
if BOARD_GECKO_DEVELOPMENT

config BT_CTLR
	default BT

endif # BOARD_GECKO_DEVELOPMENT
```

## Firmware/boards/Slotech/gecko_display_test/Kconfig.defconfig
```kconfig
if BOARD_GECKO_DISPLAY_TEST

config BT_CTLR
	default BT

endif # BOARD_GECKO_DISPLAY_TEST
```

## Firmware/boards/Slotech/gecko_display_test/board.yml
```yaml
board:
  name: gecko_display_test
  vendor: Slotech
  socs:
    - name: nrf52840
```

## Firmware/boards/Slotech/gecko_display_test/gecko_display_test_defconfig
```kconfig
CONFIG_ARM_MPU=y
CONFIG_HW_STACK_PROTECTION=y

CONFIG_CONSOLE=y
CONFIG_SERIAL=y
CONFIG_UART_CONSOLE=y

CONFIG_DK_LIBRARY=y
CONFIG_NEWLIB_LIBC=y
CONFIG_NEWLIB_LIBC_FLOAT_PRINTF=y
CONFIG_NEWLIB_LIBC_NANO=n # Needed to make uint64 work in printf, use %llu or %llx
CONFIG_USE_SEGGER_RTT=y
CONFIG_CBPRINTF_FP_SUPPORT=y

CONFIG_LOG=y
CONFIG_LOG_DEFAULT_LEVEL=1 

CONFIG_PWM=y
CONFIG_GPIO=y
CONFIG_SPI=y

CONFIG_DISPLAY=y
CONFIG_DISPLAY_LOG_LEVEL_ERR=y

CONFIG_MAIN_STACK_SIZE=16384

CONFIG_LV_Z_MEM_POOL_SIZE=16384
CONFIG_LVGL=y
CONFIG_LV_MEM_CUSTOM=y
CONFIG_LV_FONT_MONTSERRAT_14=y
CONFIG_LV_FONT_MONTSERRAT_24=y

CONFIG_LV_COLOR_DEPTH_16=y
CONFIG_LV_COLOR_16_SWAP=y
```

## Firmware/boards/Slotech/gecko_old_hardware/Kconfig.defconfig
```kconfig
if BOARD_GECKO_OLD_HARDWARE

config BT_CTLR
	default BT

endif # BOARD_GECKO_OLD_HARDWARE
```

## Firmware/boards/Slotech/gecko_old_hardware/board.yml
```yaml
board:
  name: gecko_old_hardware
  vendor: Slotech
  socs:
    - name: nrf52840
```

## Firmware/boards/Slotech/gecko_old_hardware/gecko_old_hardware_defconfig
```kconfig
# Enable MPU
CONFIG_ARM_MPU=y

# Enable hardware stack protection
CONFIG_HW_STACK_PROTECTION=y

# Enable Required Zephyr Stuff
CONFIG_EVENTS=y

# Enable UART Console
CONFIG_CONSOLE=y
CONFIG_SERIAL=y
CONFIG_UART_CONSOLE=y

# Configure Proper Float Printing
CONFIG_DK_LIBRARY=y
CONFIG_NEWLIB_LIBC=y
CONFIG_NEWLIB_LIBC_FLOAT_PRINTF=y
CONFIG_NEWLIB_LIBC_NANO=n # Needed to make uint64 work in printf, use %llu or %llx
CONFIG_USE_SEGGER_RTT=y
CONFIG_CBPRINTF_FP_SUPPORT=y

# Configure Logging
# Only show LOG_ERR to avoid console spam, https://docs.nordicsemi.com/bundle/ncs-1.9.2-dev1/page/kconfig/CONFIG_LOG_DEFAULT_LEVEL.html
CONFIG_LOG=y
CONFIG_LOG_DEFAULT_LEVEL=1 

# Enable SPI
CONFIG_SPI=y

# Enable PWM
CONFIG_PWM=y

# Enable GPIO
CONFIG_GPIO=y

# Enable ADC
CONFIG_ADC=y

# Enable Bluetooth
CONFIG_BT=y
CONFIG_BT_PERIPHERAL=y
CONFIG_BT_DEVICE_NAME="Gecko"
CONFIG_BT_CTLR_TX_PWR_PLUS_8=y # Highest avaliable power

# Still not sure what some of these do, neccesary for large MTU though
CONFIG_BT_BUF_ACL_RX_SIZE=251
CONFIG_BT_GATT_CLIENT=y
CONFIG_BT_ATT_PREPARE_COUNT=2
CONFIG_BT_CONN_TX_MAX=10
CONFIG_BT_L2CAP_TX_BUF_COUNT=10
CONFIG_BT_L2CAP_TX_MTU=247
CONFIG_BT_BUF_ACL_RX_SIZE=251
# CONFIG_BT_L2CAP_DYNAMIC_CHANNEL=y
CONFIG_BT_BUF_ACL_TX_SIZE=251

# Enable power management, the nordic folks claim it's no longer needed?
# CONFIG_PM=y
CONFIG_PM_DEVICE=y
CONFIG_POWEROFF=y
CONFIG_PM_DEVICE_RUNTIME=y

# Display
CONFIG_DISPLAY=y
CONFIG_DISPLAY_LOG_LEVEL_ERR=y
CONFIG_GC9A01=y

# LVGL Configuration (not setting CONFIG_LV_CONF_MINIMAL will enable everything by default)
CONFIG_LVGL=y
CONFIG_LV_MEM_CUSTOM=y
CONFIG_LV_Z_VDB_SIZE=25
CONFIG_LV_Z_MEM_POOL_SIZE=16384
CONFIG_LV_Z_FLUSH_THREAD=y
CONFIG_LV_COLOR_DEPTH_16=y
CONFIG_LV_COLOR_16_SWAP=y
CONFIG_LV_FONT_MONTSERRAT_14=y
CONFIG_LV_FONT_MONTSERRAT_24=y
```

## Firmware/boards/arm/slotech_gecko_development_nrf52840/Kconfig.board
```kconfig
# Copyright (c) 2024 Nordic Semiconductor ASA
# SPDX-License-Identifier: Apache-2.0

config BOARD_SLOTECH_GECKO_DEVELOPMENT_NRF52840
	select SOC_NRF52840_QFAA
```

## Firmware/boards/arm/slotech_gecko_development_nrf52840/slotech_gecko_development_nrf52840_defconfig
```kconfig
# Copyright (c) 2024 Nordic Semiconductor ASA
# SPDX-License-Identifier: Apache-2.0

CONFIG_SOC_SERIES_NRF52X=y
CONFIG_SOC_NRF52840_QFAA=y
CONFIG_BOARD_SLOTECH_GECKO_DEVELOPMENT_NRF52840=y

# Enable MPU
CONFIG_ARM_MPU=y

# Enable hardware stack protection
CONFIG_HW_STACK_PROTECTION=y

# Enable Required Zephyr Stuff
CONFIG_EVENTS=y

# Enable UART Console
CONFIG_CONSOLE=y
CONFIG_SERIAL=y
CONFIG_UART_CONSOLE=y

# Configure Proper Float Printing
CONFIG_DK_LIBRARY=y
CONFIG_NEWLIB_LIBC=y
CONFIG_NEWLIB_LIBC_FLOAT_PRINTF=y
CONFIG_NEWLIB_LIBC_NANO=n # Needed to make uint64 work in printf, use %llu or %llx
CONFIG_USE_SEGGER_RTT=y
CONFIG_CBPRINTF_FP_SUPPORT=y

# Configure Logging
# Only show LOG_ERR to avoid console spam, https://docs.nordicsemi.com/bundle/ncs-1.9.2-dev1/page/kconfig/CONFIG_LOG_DEFAULT_LEVEL.html
CONFIG_LOG=y
CONFIG_LOG_DEFAULT_LEVEL=1 

# Enable SPI
CONFIG_SPI=y
# CONFIG_NRFX_SPIM3=y

# Enable PWM
CONFIG_PWM=y

# Enable GPIO
CONFIG_GPIO=y

# Enable I2C
CONFIG_I2C=y

# Enable Bluetooth
CONFIG_BT=y
CONFIG_BT_PERIPHERAL=y
CONFIG_BT_DEVICE_NAME="Gecko"
CONFIG_BT_CTLR_TX_PWR_PLUS_8=y # Highest avaliable power

# Still not sure what some of these do, neccesary for large MTU though
CONFIG_BT_BUF_ACL_RX_SIZE=251
CONFIG_BT_GATT_CLIENT=y
CONFIG_BT_ATT_PREPARE_COUNT=2
CONFIG_BT_CONN_TX_MAX=10
CONFIG_BT_L2CAP_TX_BUF_COUNT=10
CONFIG_BT_L2CAP_TX_MTU=247
CONFIG_BT_BUF_ACL_RX_SIZE=251
CONFIG_BT_L2CAP_DYNAMIC_CHANNEL=y
CONFIG_BT_BUF_ACL_TX_SIZE=251

# Enable power management, the nordic folks claim it's no longer needed?
CONFIG_PM=y
CONFIG_PM_DEVICE=y
CONFIG_POWEROFF=y
CONFIG_PM_DEVICE_RUNTIME=y
```

## Firmware/boards/arm/slotech_gecko_nrf52840/Kconfig.board
```kconfig
# Copyright (c) 2024 Nordic Semiconductor ASA
# SPDX-License-Identifier: Apache-2.0

config BOARD_SLOTECH_GECKO_NRF52840
	bool "Slotech Gecko nRF52840"
	depends on SOC_NRF52840_QFAA
```

## Firmware/boards/arm/slotech_gecko_nrf52840/Kconfig.defconfig
```kconfig
# Copyright (c) 2024 Nordic Semiconductor ASA
# SPDX-License-Identifier: Apache-2.0

if BOARD_SLOTECH_GECKO_NRF52840

config BOARD
	default "slotech_gecko_nrf52840"

config BT_CTLR
   default BT

config BOARD_ENABLE_DCDC
	bool "DCDC mode"
	select SOC_DCDC_NRF52X
	default y

endif
```
